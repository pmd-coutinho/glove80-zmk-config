/*****************************************************************************/
                                /* Timers */
/*****************************************************************************/

/* Macro timers; can be increased for systems that don't like 0ms Macros */
#define FAST_MACRO_TAP_MS 0
#define FAST_MACRO_WAIT_MS 0

/* How long Sticky Keys and Sticky Layers stay pressed */
#define STICKY_KEY_RELEASE_AFTER_MS 600

/* How quickly Combo keys must be pressed together */
#define COMBO_TIMEOUT_MS 25

/* How quickly both thumb Shift keys must be pressed together to activate Caps
   Word */
#define CAPS_WORD_COMBO_TIMEOUT_MS 150

/* How long to hold to activate home row mods for same side or mouse usage */
#define HOME_ROW_MODS_TAPPING_TERM_MS 300

/* Cool down after typing before home row mods can be used */
#define HOME_ROW_MODS_REQUIRE_PRIOR_IDLE_MS 175

/* How quickly to double tap home row mods to hold down the tap action */
#define HOME_ROW_MODS_QUICK_TAP_MS 200

/* How long thumb keys can be held before rolls send the higher layer key */
#define THUMBS_TAPPING_TERM_MS 200

/* How quickly to double tap repeating thumb keys to hold the tap action */
#define REPEATING_THUMBS_QUICK_TAP_MS 250

/* How long until each phase of the capital I component of the typing assist 
   feature times out */
#define CAP_I_TIMEOUT_MS 700

/* How long until each phase of the sentence case component of the typing 
   assist feature times out */
#define SENT_CASE_TIMEOUT_MS 60000

/* How long until the dynamic repeat key feature times out */
#define REPEAT_KEY_TIMEOUT_MS 700

/* How long until the backspace word feature times out after the repeat key
   is pressed */
#define REPEAT_KEY_BACKSPACE_WORD_TIMEOUT_MS 250

/* How long to hold for Autoshift */
#define AUTOSHIFT_TAPPING_TERM_MS 200

/* How long until the word and line selection feature times out */
#define SELECT_TIMEOUT_MS 60000

/* How quickly Tap Dance keys must be double tapped to activate */
#define TAP_DANCE_TIMEOUT_MS 200

#define my_tapping_term 170
#define my_quick_tapping_term 112
#define my_ak_delay 40

#define COMBO_TIMEOUT 45

/*****************************************************************************/
                            /* Layer Conditions */
/*****************************************************************************/

/* Conditional Layer helper */
#define LAYER_CONDITION(NAME, IF, THEN) \
    NAME { \
        if-layers = <IF>; \
        then-layer = <THEN>; \
    };

/ {
    conditional_layers {
        compatible = "zmk,conditional-layers";

        /* Restrict selection continuation to Editing layer */
        LAYER_CONDITION(continue_selection, EDITING SELECT_CONT_SL, SELECT_CONT)

        /* Layer lock feature for Editing layer */
        LAYER_CONDITION(editing_mo, EDITING_MO, EDITING)
    };
};

/*****************************************************************************/
                        /* Basic Helper C Macros */
/*****************************************************************************/

/* Combo helper */
#define ZMK_COMBO(NAME, TIMEOUT_MS, KEY_POSITIONS, LAYERS, BINDINGS) \
    NAME { \
        timeout-ms = <TIMEOUT_MS>; \
        key-positions = <KEY_POSITIONS>; \
        layers = <LAYERS>; \
        bindings = <BINDINGS>; \
    }; \

/* Create a ZMK Behavior without having to specify the name three times */
#define ZMK_BEHAVIOR(NAME, ...) \
    / { \
        behaviors { \
            NAME: NAME { \
                __VA_ARGS__ \
            }; \
        }; \
    };

/* Hold-Tap helper */
#define HOLD_TAP(NAME, ...) \
    ZMK_BEHAVIOR(NAME, \
        compatible = "zmk,behavior-hold-tap"; \
        #binding-cells = <2>; \
        __VA_ARGS__ \
    )

/* Balanced Hold-Tap for home row mods and thumb layer keys */
#define BALANCED_HOLD_TAP(NAME, ...) \
    HOLD_TAP(NAME, \
        flavor = "balanced";  /* Fast hold */ \
        __VA_ARGS__ \
    )

/* Mod-Morph helper */
#define MOD_MORPH(NAME, STANDARD, MORPHED, MODS, ...) \
    ZMK_BEHAVIOR(NAME, \
        compatible = "zmk,behavior-mod-morph"; \
        #binding-cells = <0>; \
        bindings = <STANDARD>, <MORPHED>; \
        mods = <(MODS)>; \
        __VA_ARGS__ \
    )

/* Mod-Morph that sends another key when Alt is held */
#define ALT_MORPH(NAME, PRIMARY, ALTERNATE) \
    MOD_MORPH(NAME, PRIMARY, ALTERNATE, MOD_LALT|MOD_RALT)

/* Mod-Morph that sends another key when Shift is held */
#define SHIFT_MORPH(NAME, LOWER, UPPER) \
    MOD_MORPH(NAME, LOWER, UPPER, MOD_LSFT|MOD_RSFT)

/* Tap Dance helper */
#define TAP_DANCE(NAME, SINGLE, DOUBLE) \
    ZMK_BEHAVIOR(NAME, \
        compatible = "zmk,behavior-tap-dance"; \
        #binding-cells = <0>; \
        tapping-term-ms = <TAP_DANCE_TIMEOUT_MS>; \
        bindings = <SINGLE>, <DOUBLE>; \
    )

/* Wrap ZMK_MACRO to avoid needing to specify Macro node */
#define ZMKMACRO(NAME, ...) \
    / { \
        macros { \
            ZMK_MACRO(NAME, __VA_ARGS__) \
        }; \
    };

/* Wrap ZMK_MACRO1 to avoid needing to specify Macro node */
#define ZMKMACRO1(NAME, ...) \
    / { \
        macros { \
            ZMK_MACRO1(NAME, __VA_ARGS__) \
        }; \
    };

/* Instant key press Macro helper using defined timers */
#define FAST_MACRO(NAME, BINDINGS) \
    ZMKMACRO(NAME, \
        tap-ms = <FAST_MACRO_TAP_MS>; \
        wait-ms = <FAST_MACRO_WAIT_MS>; \
        bindings = <BINDINGS>; \
    )

/* Instant key press one parameter Macro helper using defined timers */
#define FAST_MACRO1(NAME, BINDINGS) \
    ZMKMACRO1(NAME, \
        tap-ms = <FAST_MACRO_TAP_MS>; \
        wait-ms = <FAST_MACRO_WAIT_MS>; \
        bindings = <BINDINGS>; \
    )

/*****************************************************************************/
                /* Sticky Layer State Machine Helper C Macros */
/*****************************************************************************/

/* Generic helper for Sticky Layer state machine actions and state
   transitions. Used to build more specific helpers for features that use this
   technique. SL_BEHAVIOR argument allows different features to use distinct
   Sticky Layer implementations. Performs state transitions seamlessly even
   when rolling into other keys. */
#define STATE_TRANSITION(NAME, ENTRY, ACTION_BINDING, SL_BEHAVIOR, \
                         NEXT_STATE_LAYER) \
    FAST_MACRO(NAME, \
        ENTRY  /* Optional setup, pass &macro_tap &... */ \
        &macro_press ACTION_BINDING  /* Main action */ \
        &macro_tap SL_BEHAVIOR NEXT_STATE_LAYER  /* Move to next state */ \
        &macro_pause_for_release  /* Hold for repeating key press */ \
        &macro_release ACTION_BINDING \
    )

/* State transition macro that allows taking an action after key release, at
   the cost of not supporting rolls into the next state. */
#define STATE_TRANSITION_WITH_EXIT(NAME, ENTRY, ACTION_BINDING, EXIT, \
                                   SL_BEHAVIOR, NEXT_STATE_LAYER) \
    FAST_MACRO(NAME, \
        ENTRY  /* Optional setup, pass &macro_tap &... */ \
        &macro_press ACTION_BINDING  /* Main action */ \
        &macro_pause_for_release  /* Hold for repeating key press */ \
        &macro_release ACTION_BINDING \
        EXIT \
        &macro_tap SL_BEHAVIOR NEXT_STATE_LAYER  /* Move to next state */ \
    )

/* Sticky Layer Behavior definition helper */
#define STICKY_LAYER_HELPER(NAME, TIMEOUT_MS, ...) \
    ZMK_BEHAVIOR(NAME, \
        compatible = "zmk,behavior-sticky-key"; \
        #binding-cells = <1>; \
        release-after-ms = <TIMEOUT_MS>;  /* Release if no key is pressed */ \
        bindings = <&mo>; \
        __VA_ARGS__ \
    )

/* Quick release Sticky Layer */
#define STICKY_LAYER_QUICK_RELEASE(NAME, TIMEOUT_MS) \
    STICKY_LAYER_HELPER(NAME, TIMEOUT_MS, \
        quick-release;  /* Release as soon as another key is pressed */ \
        ignore-modifiers;  /* Mods do not release Sticky Layer */ \
    )

/* Quick release Sticky Layer that does not ignore modifiers */
#define STICKY_LAYER_NO_MODS(NAME, TIMEOUT_MS) \
    STICKY_LAYER_HELPER(NAME, TIMEOUT_MS, \
        quick-release;  /* Release as soon as another key is pressed */ \
        /delete-property/ ignore-modifiers;  /* Mods release Sticky Layer */ \
    )

/* Helper for defining Mod Morph filters for catching modifiers on a state
   Sticky Layer that does not ignore them in order to reset the state
   machine */
#define MOD_FILTER_HELPER(NAME, STANDARD, FILTERED, MODS) \
    MOD_MORPH(NAME, STANDARD, FILTERED, MODS, \
        keep-mods = <(MODS)>; \
    )

/* Filter for catching catching all mods */
#define FILTER_ALL_MODS(NAME, STANDARD, FILTERED) \
    MOD_FILTER_HELPER(NAME, STANDARD, FILTERED, \
        MOD_LSFT|MOD_RSFT|MOD_LCTL|MOD_RCTL|MOD_LALT|MOD_RALT|MOD_LGUI| \
        MOD_RGUI \
    )

/* Filter for catching all mods except Shift */
#define FILTER_NON_SHIFT_MODS(NAME, STANDARD, FILTERED) \
    MOD_FILTER_HELPER(NAME, STANDARD, FILTERED, \
        MOD_LCTL|MOD_RCTL|MOD_LALT|MOD_RALT|MOD_LGUI|MOD_RGUI \
    )

/*****************************************************************************/
                            /* Behavior Changes */
/*****************************************************************************/

/ {
    behaviors {

        /* Let Caps Word continue when typing Underscore */
        caps_word {
            continue-list = <UNDERSCORE MINUS BACKSPACE DELETE LEFT RIGHT>;
        };

        /* Use defined timer for Sticky Keys */
        sticky_key {
            release-after-ms = <STICKY_KEY_RELEASE_AFTER_MS>;
            quick-release;
        };

        /* Use defined timer for Sticky Layers */
        sticky_layer {
            release-after-ms = <STICKY_KEY_RELEASE_AFTER_MS>;
        };

        mt {
            tapping-term-ms = <my_tapping_term>;
        };
        sl {
            release-after-ms = <my_tapping_term>;
        };
    };
};

/*****************************************************************************/
                                /* Combos */
/*****************************************************************************/

/* Limit to base layers and use defined timer for most Combos */
#define COMBO(NAME, KEY_POSITIONS, BINDINGS) \
    ZMK_COMBO(NAME, COMBO_TIMEOUT_MS, KEY_POSITIONS, BASE_LAYERS, BINDINGS)

/ {
    combos {
        compatible = "zmk,combos";

        /* Escape with left home thumb (Space) and left upper pinky (Q) */
        COMBO(combo_esc, 23 69, &kp ESC)

        /* Caps Word with left and right upper inner thumb keys (Shift) using
        defined timer */
        ZMK_COMBO(combo_caps_word, CAPS_WORD_COMBO_TIMEOUT_MS, 52 57, \
            BASE_LAYERS, &caps_word \
        )
    };
};


/*****************************************************************************/
                            /* Thumb Layer Keys */
/*****************************************************************************/

/* Home thumb layer tap without quick tap; faster layer switching */
#define FAST_SWITCHING_THUMB_LAYER_TAP(NAME, TAP_BINDING) \
    BALANCED_HOLD_TAP(NAME, \
        tapping-term-ms = <THUMBS_TAPPING_TERM_MS>;  /* Rolls send tap key */ \
        bindings = <&mo>, <TAP_BINDING>; \
    )

#define FAST_SWITCHING_THUMB_LAYER_TAP1(NAME, TAP_BINDING) \
    BALANCED_HOLD_TAP(NAME, \
        tapping-term-ms = <THUMBS_TAPPING_TERM_MS>;  /* Rolls send tap key */ \
        bindings = <&mo>, <TAP_BINDING>; \
        quick-tap-ms = <150>;  /* 2x tap repeats */ \
    )

/* Reaching thumb layer tap with double tap to repeat */
#define REPEATING_THUMB_LAYER_TAP(NAME, TAP_BINDING) \
    BALANCED_HOLD_TAP(NAME, \
        tapping-term-ms = <THUMBS_TAPPING_TERM_MS>;  /* Rolls send tap key */ \
        quick-tap-ms = <REPEATING_THUMBS_QUICK_TAP_MS>;  /* 2x tap repeats */ \
        bindings = <&mo>, <TAP_BINDING>; \
    )

/* Used on Base, Editing and Numbers layers to enable fast switching */
FAST_SWITCHING_THUMB_LAYER_TAP(fst_lt, &kp)
FAST_SWITCHING_THUMB_LAYER_TAP1(fst_lt1, &kp)

/* Used on Media and Function layers for Tab and Enter to enable hold to 
   repeat */
REPEATING_THUMB_LAYER_TAP(rt_lt, &kp)


/*****************************************************************************/
                        /* Triple Function Shift Keys */
/*****************************************************************************/

/* Instant Caps Lock on Mac OS */
ZMKMACRO(instant_caps_lock, \
    tap-ms = <200>;  /* Mac OS ignores short taps on Caps Lock */
    bindings = <&kp CAPS>;
)

/* Triple function left Shift */
MOD_MORPH(lshft_caps, &sk LSHFT, &instant_caps_lock, MOD_LSFT)

/* Triple function right Shift with Mac/PC support */
MOD_MORPH(rshft_bspcwd_mac, &sk RSHFT, &kp LA(BACKSPACE), MOD_RSFT)
MOD_MORPH(rshft_bspcwd_pc, &sk RSHFT, &kp LC(BACKSPACE), MOD_RSFT)

/*****************************************************************************/
                    /* Custom Base Layer Punctuation */
/*****************************************************************************/

/* Custom base layer punctuation */
SHIFT_MORPH(comma_semi, &kp COMMA, &kp SEMI)
SHIFT_MORPH(dot_colon, &kp DOT, &kp COLON)
SHIFT_MORPH(question_excl, &kp QUESTION, &kp EXCL)

/*****************************************************************************/
                    /* Numbers Layer Custom Shifted Pairs */
/*****************************************************************************/

/* Autoshift Behavior using defined timer */
#define AUTOSHIFT(NAME, HOLD, TAP) \
    HOLD_TAP(NAME, \
        flavor = "tap-preferred"; \
        tapping-term-ms = <AUTOSHIFT_TAPPING_TERM_MS>;  /* Hold for Shift */ \
        bindings = <HOLD>, <TAP>; \
    )

AUTOSHIFT(as, &kp, &kp)  /* Main Autoshift Behavior */

/* Autoshifting Mod-Morph Behavior that sends another key when Shift is held */
#define AUTOSHIFT_MORPH(NAME, LOWER, UPPER) \
    SHIFT_MORPH(NAME, &as UPPER LOWER, &kp UPPER)

/* Numbers layer custom number and symbol pairs with Autoshift */
AUTOSHIFT_MORPH(as_bslh_caret, BSLH, CARET)
AUTOSHIFT_MORPH(as_n7_lbkt, N7, LBKT)
AUTOSHIFT_MORPH(as_n8_rbkt, N8, RBKT)
AUTOSHIFT_MORPH(as_n9_star, N9, STAR)
AUTOSHIFT_MORPH(as_fslh_amps, FSLH, AMPS)
AUTOSHIFT_MORPH(as_colon_excl, COLON, EXCL)
AUTOSHIFT_MORPH(as_n4_lpar, N4, LPAR)
AUTOSHIFT_MORPH(as_n5_rpar, N5, RPAR)
AUTOSHIFT_MORPH(as_n6_equal, N6, EQUAL)
AUTOSHIFT_MORPH(as_hash_pipe, HASH, PIPE)
AUTOSHIFT_MORPH(as_at_prcnt, AT, PRCNT)
AUTOSHIFT_MORPH(as_n1_lbrc, N1, LBRC)
AUTOSHIFT_MORPH(as_n2_rbrc, N2, RBRC)
AUTOSHIFT_MORPH(as_n3_dllr, N3, DLLR)
AUTOSHIFT_MORPH(as_grave_tilde, GRAVE, TILDE)
AUTOSHIFT_MORPH(as_minus_plus, MINUS, PLUS)
AUTOSHIFT_MORPH(as_n0_under, N0, UNDER)
AUTOSHIFT_MORPH(as_lt_gt, LT, GT)
AUTOSHIFT_MORPH(as_f9_f10, F9, F10)
AUTOSHIFT_MORPH(as_f11_f12, F11, F12)

/*****************************************************************************/
                /* Editing Layer Alternative Shortcuts */
/*****************************************************************************/

/* Editing layer alternative shortcuts with Mac/PC support */
ALT_MORPH(copy_sel_all_mac, &kp LG(C), &kp LG(A))
ALT_MORPH(copy_sel_all_pc, &kp LC(C), &kp LC(A))
ALT_MORPH(paste_undo_mac, &kp LG(V), &kp LG(Z))
ALT_MORPH(paste_undo_pc, &kp LC(V), &kp LC(Z))

/*****************************************************************************/
                /* One-Handed Opposite Layer Access */
/*****************************************************************************/

AUTOSHIFT(tog_sl, &tog, &sl)  /* Tap for a single key press, hold to lock */

/*****************************************************************************/
                        /* Word & Line Selection */
/*****************************************************************************/

/* Quick release Sticky Layer Behavior that does not ignore modifiers using
   defined timer for continuing the word and line selection feature */
STICKY_LAYER_NO_MODS(sl_select_cont, SELECT_TIMEOUT_MS)

/* Select Macro definition helper */
#define SELECT_HELPER(NAME, SETUP, SELECTION_BINDING, CLEANUP) \
    STATE_TRANSITION_WITH_EXIT(NAME, SETUP, SELECTION_BINDING, CLEANUP, \
        &sl_select_cont, SELECT_CONT_SL)

/* Select word start Macro helper */
#define SELECT_WORD_START_MACRO(NAME, SETUP_BINDINGS, SELECTION_BINDING) \
    SELECT_HELPER(NAME, &macro_tap SETUP_BINDINGS, SELECTION_BINDING, \
        /* No CLEANUP */)

/* Select line start Macro helper */
#define SELECT_LINE_START_MACRO(NAME, SETUP_BINDINGS, SELECTION_BINDING, \
                                CLEANUP_BINDINGS) \
    SELECT_HELPER(NAME, &macro_tap SETUP_BINDINGS, SELECTION_BINDING, \
        &macro_tap CLEANUP_BINDINGS)

/* Select word continue Macro helper */
#define SELECT_WORD_CONT_MACRO(NAME, SELECTION_BINDING) \
    SELECT_HELPER(NAME, /* No SETUP */, SELECTION_BINDING, /* No CLEANUP */)

/* Select line continue Macro helper */
#define SELECT_LINE_CONT_MACRO(NAME, SELECTION_BINDING, CLEANUP_BINDINGS) \
    SELECT_HELPER(NAME, /* No SETUP */, SELECTION_BINDING, \
        &macro_tap CLEANUP_BINDINGS)

/* Movement, jumping and selection helper macros */
#define MAC_WF   LA(RIGHT)              /* Jump forward a word on Mac */
#define MAC_WB   LA(LEFT)               /* Jump backward a word on Mac */
#define MAC_HOME LG(LEFT)               /* Jump to start of line on Mac */
#define PC_WF    LC(RIGHT)              /* Jump forward a word on PC */
#define PC_WB    LC(LEFT)               /* Jump backward a word on PC */
#define PC_HOME  HOME                   /* Jump to start of line on PC */
#define SEL(MOVEMENT) &kp LS(MOVEMENT)  /* Select text */

/* Jump to start or end of word regardless of cursor position */
#define MAC_START_OF_WD &kp MAC_WF &kp MAC_WB
#define MAC_END_OF_WD &kp MAC_WB &kp MAC_WF
#define PC_START_OF_WD &kp PC_WF &kp PC_WB
#define PC_END_OF_WD &kp PC_WB &kp PC_WF

/* We use LG(LEFT) / HOME twice to avoid an issue with IDEs being too smart and
   placing the cursor after the indenting whitespace */
#define MAC_START_OF_LN &kp MAC_HOME &kp MAC_HOME
#define MAC_START_OF_NEXT_LN &kp DOWN &kp MAC_HOME &kp MAC_HOME
#define MAC_SEL_START_OF_LN SEL(MAC_HOME) SEL(MAC_HOME)
#define PC_START_OF_LN &kp PC_HOME &kp PC_HOME
#define PC_START_OF_NEXT_LN &kp DOWN &kp PC_HOME &kp PC_HOME
#define PC_SEL_START_OF_LN SEL(PC_HOME) SEL(PC_HOME)

/* Word select Macros for Mac */
SELECT_WORD_START_MACRO(sel_wd_fwd_mac, MAC_START_OF_WD, SEL(MAC_WF))
SELECT_WORD_START_MACRO(sel_wd_bwd_mac, MAC_END_OF_WD, SEL(MAC_WB))
SELECT_WORD_CONT_MACRO(cont_sel_wd_fwd_mac, SEL(MAC_WF))
SELECT_WORD_CONT_MACRO(cont_sel_wd_bwd_mac, SEL(MAC_WB))

/* Word select Macros for PC */
SELECT_WORD_START_MACRO(sel_wd_fwd_pc, PC_START_OF_WD, SEL(PC_WF))
SELECT_WORD_START_MACRO(sel_wd_bwd_pc, PC_END_OF_WD, SEL(PC_WB))
SELECT_WORD_CONT_MACRO(cont_sel_wd_fwd_pc, SEL(PC_WF))
SELECT_WORD_CONT_MACRO(cont_sel_wd_bwd_pc, SEL(PC_WB))

/* Line select Macros for Mac */
SELECT_LINE_START_MACRO(sel_ln_fwd_mac, \
    MAC_START_OF_LN, SEL(DOWN), MAC_SEL_START_OF_LN)
SELECT_LINE_START_MACRO(sel_ln_bwd_mac, \
    MAC_START_OF_NEXT_LN, SEL(UP), MAC_SEL_START_OF_LN)
SELECT_LINE_CONT_MACRO(cont_sel_ln_fwd_mac, SEL(DOWN), MAC_SEL_START_OF_LN)
SELECT_LINE_CONT_MACRO(cont_sel_ln_bwd_mac, SEL(UP), MAC_SEL_START_OF_LN)

/* Line select Macros for PC */
SELECT_LINE_START_MACRO(sel_ln_fwd_pc, \
    PC_START_OF_LN, SEL(DOWN), PC_SEL_START_OF_LN)
SELECT_LINE_START_MACRO(sel_ln_bwd_pc, \
    PC_START_OF_NEXT_LN, SEL(UP), PC_SEL_START_OF_LN)
SELECT_LINE_CONT_MACRO(cont_sel_ln_fwd_pc, SEL(DOWN), PC_SEL_START_OF_LN)
SELECT_LINE_CONT_MACRO(cont_sel_ln_bwd_pc, SEL(UP), PC_SEL_START_OF_LN)

/*****************************************************************************/
                    /* System Layer */
/*****************************************************************************/

/* Native ZMK Macros for selecting Bluetooth profiles */
#define SELECT_BLUETOOTH_OUTPUT(NAME, BT_PROFILE_NUMBER) \
    FAST_MACRO(NAME, &out OUT_BLE &bt BT_SEL BT_PROFILE_NUMBER)
SELECT_BLUETOOTH_OUTPUT(out_bt_0, 0)
SELECT_BLUETOOTH_OUTPUT(out_bt_1, 1)
SELECT_BLUETOOTH_OUTPUT(out_bt_2, 2)
SELECT_BLUETOOTH_OUTPUT(out_bt_3, 3)
TAP_DANCE(out_disc_bt_0, &out_bt_0, &bt BT_DISC 0)
TAP_DANCE(out_disc_bt_1, &out_bt_1, &bt BT_DISC 1)
TAP_DANCE(out_disc_bt_2, &out_bt_2, &bt BT_DISC 2)
TAP_DANCE(out_disc_bt_3, &out_bt_3, &bt BT_DISC 3)

/* Native ZMK Macro for clearing all Bluetooth profiles */
FAST_MACRO(bt_clr_all_macro, &macro_tap \
    &bt BT_SEL 0 &bt BT_CLR \
    &bt BT_SEL 1 &bt BT_CLR \
    &bt BT_SEL 2 &bt BT_CLR \
    &bt BT_SEL 3 &bt BT_CLR \
    &bt BT_SEL 0 \
)

/* Double tap to confirm dangerous actions using defined timer */
#define DOUBLE_TAP(NAME, BINDING) \
    TAP_DANCE(NAME, &none, BINDING)

DOUBLE_TAP(confirm_bt_clr, &bt BT_CLR)  /* Clear current Bluetooth profile */
DOUBLE_TAP(confirm_bt_clr_all, &bt_clr_all_macro)  /* Clear all BT profiles */

/* The reset Behaviors always reset the left half of the keyboard when nested
   in a Tap-Dance; reference ZMK issue #1494 */
// DOUBLE_TAP(confirm_reset, &sys_reset)  /* Soft reset */
// DOUBLE_TAP(confirm_bootloader, &bootloader)  /* Bootloader reset */

/* Macros for turning layers on or off */
FAST_MACRO1(on, &macro_tap &macro_param_1to1 &mo MACRO_PLACEHOLDER \
    &macro_param_1to1 &tog MACRO_PLACEHOLDER \
)
FAST_MACRO1(off, &macro_tap &macro_param_1to1 &mo MACRO_PLACEHOLDER)

/*****************************************************************************/
                /* Editing & Number Layer Lock Status */
/*****************************************************************************/

/* Feature status helper */
#define FEATURE_STATUS(NAME, STATUS_BINDINGS, BACKSPACE_BINDINGS) \
    ZMKMACRO(NAME, \
        tap-ms = <FAST_MACRO_TAP_MS>; \
        wait-ms = <15>; \
        bindings \
            = <&kp SPACE STATUS_BINDINGS &kp SPACE> \
            , <&macro_wait_time 500 &none &macro_wait_time 15> \
            , <&kp BACKSPACE BACKSPACE_BINDINGS &kp BACKSPACE> \
            ; \
    )

/* Editing & Number layer lock status */
FEATURE_STATUS(editing_numbers_status_locked,
    &kp LS(L) &kp LS(O) &kp LS(C) &kp LS(K) &kp LS(E) &kp LS(D), \
    &kp BACKSPACE &kp BACKSPACE &kp BACKSPACE &kp BACKSPACE &kp BACKSPACE \
    &kp BACKSPACE \
)